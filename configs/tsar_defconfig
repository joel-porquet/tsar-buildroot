## configs/tsar_defconfig
```kconfig
BR2_mipsel=y
BR2_mips_32r2=y
BR2_TOOLCHAIN_EXTERNAL=y
BR2_TOOLCHAIN_EXTERNAL_CUSTOM=y
BR2_TOOLCHAIN_EXTERNAL_PATH="${HOME}/work/crosstool-test/x-tools/mipsel-tsar-linux-uclibc"
BR2_TOOLCHAIN_EXTERNAL_CUSTOM_PREFIX="mipsel-tsar-linux-uclibc"
BR2_TOOLCHAIN_EXTERNAL_HEADERS_3_13=y
BR2_TOOLCHAIN_EXTERNAL_LARGEFILE=y
BR2_TARGET_GENERIC_GETTY_PORT="ttyVTTY0"
BR2_LINUX_KERNEL=y
BR2_LINUX_KERNEL_CUSTOM_TARGET_ARCH=y
BR2_LINUX_KERNEL_TARGET_ARCH="tsar"
BR2_LINUX_KERNEL_CUSTOM_LOCAL=y
BR2_LINUX_KERNEL_CUSTOM_LOCAL_PATH="${HOME}/work/linux"
BR2_LINUX_KERNEL_DEFCONFIG="tsarv5_multicpu_soclib"
BR2_LINUX_KERNEL_VMLINUX=y
BR2_PACKAGE_BUSYBOX_CONFIG="board/tsar/busybox.config"
BR2_TARGET_ROOTFS_INITRAMFS=y
# BR2_TARGET_ROOTFS_TAR is not set
```

## package/epfilter/Config.in
```kconfig
config BR2_PACKAGE_EPFILTER
    bool "epfilter"
    help
        Philips image filtering application
```
